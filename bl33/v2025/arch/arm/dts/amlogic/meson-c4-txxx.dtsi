// SPDX-License-Identifier: (GPL-2.0+ OR MIT)
/*
 * Copyright (c) 2019 Amlogic, Inc. All rights reserved.
 */

#include "amlogic/meson-c4.dtsi"
#include "amlogic/meson-c4-mali.dtsi"

/ {
	compatible = "amlogic,txxx", "amlogic,meson-c4";
};

&ethmac {
	phy-mode = "rmii";
//	phy-handle = <&external_phy>;
};

// SPDX-License-Identifier: (GPL-2.0+ OR MIT)
/*
 * Copyright (c) 2025 Amlogic, Inc. All rights reserved.
 */

#include "amlogic/meson-c5.dtsi"
#include "amlogic/meson-c5-mali.dtsi"

/ {
	compatible = "amlogic,txxx", "amlogic,meson-c5";
};

&ethmac {
	phy-mode = "rmii";
//	phy-handle = <&external_phy>;
};

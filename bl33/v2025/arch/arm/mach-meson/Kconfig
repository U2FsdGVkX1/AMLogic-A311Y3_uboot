## bl33/v2025/board/amlogic/c4_bz409/Kconfig
```kconfig
if TARGET_C4_BZ409

config SYS_SOC
	default "c4"

config SYS_BOARD
	default "c4_bz409"

config SYS_VENDOR
	default "amlogic"

config SYS_CONFIG_NAME
	default "c4_bz409"

config DTB_BIND_KERNEL
    bool "load dtb from boot part but not flash rsv"
    default n

config AML_REBOOT
       bool "reboot cmd"
       default y
       help
         support uboot reboot cmd
endif
```

## bl33/v2025/board/amlogic/c5_skt/Kconfig
```kconfig
if TARGET_C5_SKT

config SYS_SOC
	default "c5"

config SYS_BOARD
	default "c5_skt"

config SYS_CONFIG_NAME
	default "c5_skt"

config DTB_BIND_KERNEL
    bool "load dtb from boot part but not flash rsv"
    default n

config BL30_SELECT
	string "c5 BL30 board config"
	default "c5_pxp"

config CMD_PLLTEST
        bool "support plltest command"
        default n
		help
			support plltest command

config AML_REBOOT
		bool "reboot cmd"
		default y
		help
			support uboot reboot cmd

config ENABLE_AML_GPIO_UPGRADE
    bool "upgrade key check"
    default n

config AML_GPIO_UPGRADE_KEY
    string "gpio key"
    default ""
endif
```

## bl33/v2025/board/amlogic/t6w_skt/Kconfig
```kconfig
if TARGET_T6W_SKT

config SYS_SOC
	default "t6w"

config SYS_BOARD
	default "t6w_skt"

config SYS_CONFIG_NAME
	default "t6w_skt"

config DTB_BIND_KERNEL
    bool "load dtb from boot part but not flash rsv"
    default n

config BL30_SELECT
				string "t6w BL30 board config"
								default "t6w_pxp"

config CMD_PLLTEST
        bool "support plltest command"
        default n
        help
            support plltest command

config AML_REBOOT
        bool "reboot cmd"
        default y
        help
            support uboot reboot cmd
endif
```

## bl33/v2025/configs/amlogic/c5_cb409_defconfig
```kconfig
CONFIG_ARM=y
CONFIG_ARCH_MESON=y
CONFIG_TEXT_BASE=0x00000000
CONFIG_SYS_MALLOC_LEN=0x10000000
CONFIG_ENV_SOURCE_FILE="../env/linux"
CONFIG_DM_GPIO=y
CONFIG_DEFAULT_DEVICE_TREE="meson-c5-cb409"
CONFIG_OF_LIBFDT_OVERLAY=y
CONFIG_MESON_C5=y
CONFIG_AMLOGIC_MODIFY=y
CONFIG_AMLOGIC_RAMDUMP=y
CONFIG_SECURE_POWER_CONTROL=y
CONFIG_AML_TSENSOR=y
CONFIG_AML_TSENSOR_COOL=y
CONFIG_KEY_PRESERVE=y
CONFIG_AMLOGIC_ETH=y
CONFIG_AMLOGIC_EMMC=y
CONFIG_AMLOGIC_MIN_RESERVED_PARTITION=y
CONFIG_C5_CB409=y
CONFIG_DDR_FASTBOOT=y
CONFIG_AMLOGIC_AMFC=y
CONFIG_ENABLE_AML_GPIO_UPGRADE=y
CONFIG_AML_GPIO_UPGRADE_KEY="GPIOD_2"
CONFIG_SYS_LOAD_ADDR=0x1000000
CONFIG_DEBUG_UART_BASE=0xffa1e000
CONFIG_DEBUG_UART_CLOCK=24000000
CONFIG_ARMV8_CRYPTO=y
CONFIG_DEBUG_UART=y
CONFIG_OF_BOARD_SETUP=y
CONFIG_BOOTCOMMAND="run storeboot"
CONFIG_USE_PREBOOT=y
CONFIG_LOGLEVEL=7
CONFIG_SILENT_CONSOLE=y
# CONFIG_DISPLAY_CPUINFO is not set
# CONFIG_DISPLAY_BOARDINFO is not set
CONFIG_BOARD_LATE_INIT=y
CONFIG_SYS_PROMPT="c5_cb409# "
# CONFIG_CMD_BDI is not set
CONFIG_CMD_ADTIMG=y
# CONFIG_CMD_IMI is not set
CONFIG_CMD_CLK=y
CONFIG_CMD_GPIO=y
CONFIG_CMD_I2C=y
# CONFIG_CMD_LOADB is not set
# CONFIG_CMD_LOADS is not set
CONFIG_CMD_MMC=y
CONFIG_AML_STORAGE=y
CONFIG_CMD_SPI=y
CONFIG_CMD_USB=y
CONFIG_CMD_WDT=y
# CONFIG_CMD_SETEXPR is not set
CONFIG_CMD_CACHE=y
CONFIG_CMD_INI=y
CONFIG_CMD_CLKMSR=y
CONFIG_CMD_SARADC=y
CONFIG_CMD_IR=y
CONFIG_CMD_JTAG=y
# CONFIG_CMD_MESON is not set
CONFIG_OF_CONTROL=y
CONFIG_OF_EMBED=y
CONFIG_ENV_IS_IN_STORAGE=y
CONFIG_ADC=y
CONFIG_CLK=y
CONFIG_CLK_CCF=y
CONFIG_USB_FUNCTION_FASTBOOT=y
CONFIG_FASTBOOT_FLASH=y
CONFIG_FASTBOOT_FLASH_MMC_DEV=1
CONFIG_DM_I2C=y
CONFIG_MISC=y
CONFIG_MMC_HS200_SUPPORT=y
CONFIG_MMC_MESON_GX=y
CONFIG_PHYLIB=y
CONFIG_PHY=y
CONFIG_PINCTRL=y
CONFIG_DM_REGULATOR=y
CONFIG_DM_PWM=y
CONFIG_PWM_MESON=y
CONFIG_DEBUG_UART_ANNOUNCE=y
CONFIG_DEBUG_UART_SKIP_INIT=y
CONFIG_MESON_SERIAL=y
CONFIG_SPI=y
CONFIG_DM_SPI=y
CONFIG_TEE=y
CONFIG_OPTEE=y
CONFIG_USB=y
CONFIG_USB_XHCI_HCD=y
CONFIG_USB_DWC3=y
CONFIG_USB_GADGET=y
# CONFIG_WATCHDOG_AUTOSTART is not set
CONFIG_WDT=y
CONFIG_AML_DRIVER=y
CONFIG_UNIFY_KEY_MANAGE=y
CONFIG_SECURE_STORAGE=y
CONFIG_MESON_LEDS_STATE_CONTROL=y
CONFIG_AML_CRYPTO_64=y
CONFIG_AML_CRYPTO_V2=y
CONFIG_PHY_AMLOGIC=y
CONFIG_PINCTRL_MESON_X1=y
CONFIG_PINCTRL_MESON_C5=y
CONFIG_AML_SPICCV2=y
CONFIG_AMLOGIC_USB=y
CONFIG_USB_XHCI_MESON_DWC3=y
CONFIG_AMLOGIC_USB2_PHY=y
CONFIG_AMLOGIC_USB3_PHY=y
CONFIG_USB_GADGET_DWC3=y
CONFIG_WDT_MESON=y
CONFIG_AMLOGIC_SARADC=y
CONFIG_EFUSE=y
CONFIG_SYS_I2C_MESON_V2=y
CONFIG_AML_FACTORY_BURN_LOCAL_UPGRADE=y
CONFIG_AML_V3_FACTORY_BURN=y
CONFIG_AML_V3_USB_TOOl=y
CONFIG_BZIP2=y
```

## bl33/v2025/drivers/amlogic/amfc/Kconfig
```kconfig
config AMLOGIC_AMFC
	tristate "Amlogic AMFC driver"
	default n
	help
	  Amlogic AMFC driver

	  Hardware compress/decompress module

config AMFC_COMPRESS
	bool "AMFC compress support"
	depends on AMLOGIC_AMFC
	default y
	help
	  Amlogic AMFC compress support
	  Hardware compress/decompress module
	  Some socs do not have enc in IP, set this config to N
```

## bl33/v2025/drivers/amlogic/clock/Kconfig
```kconfig
config CLK_MESON_C4
	bool "Enable clock support for Amlogic C4"
	depends on CLK && ARCH_MESON
	default MESON_C4
	help
	  Enable clock support for the Amlogic C4 SoC family, such as
	  the SKT

config CLK_MESON_A9
	bool "Enable clock support for Amlogic A9"
	depends on CLK && ARCH_MESON
	default MESON_A9
	help
	  Enable clock support for the Amlogic A9 SoC family, such as
	  the SKT

config CLK_MESON_T6D
	bool "Enable clock support for Amlogic T6D"
	depends on CLK && ARCH_MESON
	default MESON_T6D
	help
	  Enable clock support for the Amlogic T6D SoC family

config CLK_MESON_T6W
	bool "Enable clock support for Amlogic T6W"
	depends on CLK && ARCH_MESON
	default MESON_T6W
	help
	  Enable clock support for the Amlogic T6W SoC family, such as
	  the SKT

config CLK_MESON_S7
	bool "Enable clock support for Amlogic S7"
	depends on CLK && ARCH_MESON && CLK_CCF
	default MESON_S7
	help
	  Enable clock support for the Amlogic S7 SoC family, such as
	  the SKT

config CLK_MESON_X1
	bool "Enable clock support for Amlogic X1"
	depends on CLK && ARCH_MESON
	default MESON_X1
	help
	  Enable clock support for the Amlogic X1 SoC family, such as
	  the SKT

config CLK_MESON_C5
	bool "Enable clock support for Amlogic C5"
	depends on CLK && ARCH_MESON
	default MESON_C5
	help
	  Enable clock support for the Amlogic C5 SoC family, such as
	  the SKT
```

## bl33/v2025/drivers/amlogic/i2c/Kconfig
```kconfig
#
#Amlogic I2C control drivers
#

config SYS_I2C_MESON
	bool "Amlogic Meson SoC I2C driver"
	default n
	help
	  Say Y here if you want to use the Meson I2C control.

config SYS_I2C_MESON_V2
	bool "Amlogic Meson SoC I2C V2 driver"
	default n
	help
	  Say Y here if you want to use the Meson I2C V2 control.
```

## bl33/v2025/drivers/amlogic/media/vout/meson_tx_connector/dptx/dp20/Kconfig
```kconfig
# SPDX-License-Identifier: (GPL-2.0+ OR MIT)

#
# DPTX
#
menu "Amlogic DPTX Module"

config AMLOGIC_DPTX
	bool "AMLOGIC DPTX driver"
	select AMLOGIC_DPTX_DRIVER

	help
	This option is used to configure Amlogic drivers
        of the dp tx output

endmenu
```

## bl33/v2025/drivers/amlogic/pinctrl/Kconfig
```kconfig
if ARCH_MESON

config PINCTRL_MESON_T6D
	bool "Amlogic Meson T6D SoC pinctrl driver"
	select PINCTRL_MESON_AXG_PMX

config PINCTRL_MESON_T6W
	bool "Amlogic Meson T6W SoC pinctrl driver"
	select PINCTRL_MESON_AXG_PMX

config PINCTRL_MESON_S7
	bool "Amlogic Meson S7 SoC pinctrl driver"
	select PINCTRL_MESON_AXG_PMX

config PINCTRL_MESON_X1
	bool "Amlogic Meson X1 SoC pinctrl driver"
	select PINCTRL_MESON_AXG_PMX

config PINCTRL_MESON_C4
	bool "Amlogic Meson C4 SoC pinctrl driver"
	select PINCTRL_MESON_AXG_PMX

config PINCTRL_MESON_A9
	bool "Amlogic Meson A9 SoC pinctrl driver"
	select PINCTRL_MESON_AXG_PMX

config PINCTRL_MESON_C5
	bool "Amlogic Meson C5 SoC pinctrl driver"
	select PINCTRL_MESON_AXG_PMX

endif
```

## bl33/v2025/drivers/i3c/master/Kconfig
```kconfig
config AMLOGIC_I3C_MASTER
	tristate "Amlogic I3C Dual-Role Master driver"
	depends on I3C
	help
	  Support for Silvaco I3C Dual-Role Master Controller.
```
